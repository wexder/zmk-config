## config/west.yml
```yaml
manifest:
  remotes:
    - name: zmkfirmware
      url-base: https://github.com/zmkfirmware
  projects:
    - name: zmk
      remote: zmkfirmware
      revision: main
      import: app/west.yml
  self:
    path: config
#
# manifest:
#   remotes:
#     - name: zmkfirmware
#       url-base: https://github.com/Xoffio/
#   projects:
#     - name: zmk
#       remote: zmkfirmware
#       revision: xo-status-fx
#       import: app/west.yml
#   self:
#    path: config
```
